## drivers/oneplus/input/Kconfig
```kconfig
# oem device deriver
source "drivers/oneplus/input/touchscreen/Kconfig"
source "drivers/oneplus/input/touchscreen_himax/Kconfig"
source "drivers/oneplus/input/fingerprint/Kconfig"

config OP_HIMAX
       default n
       bool "Enable/Disable the touchscreen_himax driver"
```

## drivers/oneplus/input/touchscreen/Goodix/GT9886/Kconfig
```kconfig
config TOUCHPANEL_GOODIX_GT9886
   default y
    bool "TP goodix gt9886 IC enabled"
    ---help---
    say Y to enable driver for Touchpanel useing goodix gt9886
```

## drivers/oneplus/input/touchscreen/Goodix/GT9897/Kconfig
```kconfig
config TOUCHPANEL_GOODIX_GT9897
#   default y
    bool "TP goodix gt9897 IC enable"
    ---help---
    say Y to enable driver for Touchpanel useing goodix gt9897

#endif
```

## drivers/oneplus/input/touchscreen/Goodix/Kconfig
```kconfig
source "drivers/oneplus/input/touchscreen/Goodix/GT9886/Kconfig"
source "drivers/oneplus/input/touchscreen/Goodix/GT9897/Kconfig"
```

## drivers/oneplus/input/touchscreen/Kconfig
```kconfig
	
source "drivers/oneplus/input/touchscreen/util_interface/Kconfig"
source "drivers/oneplus/input/touchscreen/samsung/Kconfig"
source "drivers/oneplus/input/touchscreen/synaptics/Kconfig"
source "drivers/oneplus/input/touchscreen/Goodix/Kconfig"

config OP_TOUCHSCREEN
	default y
	bool "Enable/Disable the touchscreen common driver"
```

## drivers/oneplus/input/touchscreen_himax/Kconfig
```kconfig
	
source "drivers/oneplus/input/touchscreen_himax/util_interface/Kconfig"
#source "drivers/oneplus/input/touchscreen/samsung/Kconfig"
source "drivers/oneplus/input/touchscreen_himax/himax/Kconfig"
#source "drivers/oneplus/input/touchscreen/Goodix/Kconfig"
```
